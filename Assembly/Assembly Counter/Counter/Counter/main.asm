;
; Counter.asm
;
; Created: 11/25/2023 8:58:51 PM
; Author : HanieVatani
;

.INCLUDE "M32DEF.INC"
.ORG $0 //INITIALIZE LOCATION
RJMP MAIN
.ORG $200


MAIN:

LDI R16, $04
OUT SPH, R16
OUT SPL, R16 
LDI R16, $FF 
OUT DDRA, R16 //INITIALIZE THE STACK

LDI R17, 0 //R17 IS INITIALIZED 0


LOOP:
	CALL COUNTER //CALLING SUBROUTINE COUNTER
	CPI R17, $0060 //60 SECONDS
	BRNE LOOP //BRANCH IS R17 IS EQUAL TO 60
	CLR R17
	RJMP MAIN //RESTART PROGRAM


COUNTER:
	INC R17 //R17 = R17 + 1
	OUT PORTA, R17 //PORTA = R17
	CALL DELAY //CALLING SUBROUTINE DELAY
	RET


//EXACT DELAY: 1.00036s
DELAY: //1s DELAY
	   LDI R20, 40
LOOP1: LDI R21, 200
LOOP2: LDI R22, 24
LOOP3: NOP
	   NOP
	   DEC R22
	   BRNE LOOP3

	   DEC R21
	   BRNE LOOP2

	   DEC R20
	   BRNE LOOP1
	   RET
