.INCLUDE "M32DEF.INC"

//PINS
.EQU MOTOR1A = 0
.EQU MOTOR1B = 1
.EQU MOTOR2A = 2
.EQU MOTOR2B = 3


//KEYBOARD
.EQU KEY_UP = 0
.EQU KEY_DOWN = 1
.EQU KEY_LEFT = 2
.EQU KEY_RIGHT = 3


//REGS
.DEF TEMP = R16
.DEF SPEED = R17
.DEF KEY = R18

.ORG 0
RJMP MAIN
.ORG $100


MAIN:
	//STACK INITIALIZATION
	LDI R16, $00
	OUT SPL, R16
	LDI R16, $04
	OUT SPH, R16

	//PUD = ENABLE --Pull Up Disable
	CLR TEMP
	OUT SFIOR, TEMP


	//SPEED = 255, OCR0 = SPEED, OCR2 = SPEED
	LDI SPEED, 255
	OUT OCR0, SPEED
	OUT OCR2, SPEED


	//TIMERO & TIMER2: PRESCALLER = 1, WGM00 = 1, WGM01 = 1, CLEAR ON COMPARE MATCH
	LDI TEMP, $49
	OUT TCCR0, TEMP
	OUT TCCR2, TEMP


	//PORTA: INPUT
	LDI TEMP, $00
	OUT DDRA, TEMP

	//PORTB: OUTPUT
	LDI TEMP, $FF
	OUT DDRB, TEMP

	//PORTD: OUTPUT
	LDI TEMP, $FF
	OUT DDRD, TEMP

	//CONFIG ULTRA SONIC PORTS
	SBI DDRB, 4	


LOOP:
	IN KEY, PINA

WAIT:
	IN TEMP, TIFR //if TOV0 = 0 it means that overflow happened
	SBRS TEMP, 0
	
	//INTERRUPT FLAG REGISTER 
	LDI TEMP, $01
	OUT TIFR, TEMP 

	//TRIGGER SENSOR
	RCALL TRIGGER		

	//CHECK UP 
	SBRC KEY, KEY_UP
	RCALL FORWARD

	//CHECK DOWN 
	SBRC KEY, KEY_DOWN
	RCALL BACKWARD

	//CHECK LEFT 
	SBRC KEY, KEY_LEFT
	RCALL LEFT

	//CHECK RIGHT
	SBRC KEY, KEY_RIGHT
	RCALL RIGHT

	//if none of keys were pressed  --STOP
	LDI TEMP, $00
	OUT PORTD, TEMP
	OUT PORTB, TEMP

	RJMP LOOP


FORWARD:
	//PORTD.0 = 1
	SBI PORTD, 0
	          
	//MOTOR1: FORWARD
	SBI PORTB, MOTOR1A
	CBI PORTB, MOTOR1B

	//MOTOR2: FORWARD
	SBI PORTB, MOTOR2A
	CBI PORTB, MOTOR2B

	RET

BACKWARD:
	//PORTD.1 = 1
	SBI PORTD, 1

	//MOTOR1: BACKWARD
	CBI PORTB, MOTOR1A  
	SBI PORTB, MOTOR1B

	//MOTOR2: BACKWARD
	CBI PORTB, MOTOR2A
	SBI PORTB, MOTOR2B

	RET

LEFT:
	//PORTD.2 = 1
	SBI PORTD, 2

	//MOTOR1: LEFT
	SBI PORTB, MOTOR1A
	CBI PORTB, MOTOR1B

	//MOTOR2: LEFT
	CBI PORTB, MOTOR2A
	SBI PORTB, MOTOR2B

	RET

RIGHT:	
	//PORTD.3 = 1
	SBI PORTD, 3

	//MOTOR1: RIGHT
	CBI PORTB, MOTOR1A
	SBI PORTB, MOTOR1B

	//MOTOR2: RIGHT
	SBI PORTB, MOTOR2A
	CBI PORTB, MOTOR2B

	RET

DELAY: ;~10us
	LDI R20, 10

//TRIGGER SENSOR
TRIGGER:	
	CBI PORTB, 4
	CALL DELAY
	SBI PORTB, 4
	CALL DELAY
	CBI PORTB, 4
	RET 

